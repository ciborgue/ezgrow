## package/adsadcd/Config.in
```kconfig
config BR2_PACKAGE_ADSADCD
	bool "adsadcd"
	depends on BR2_PACKAGE_WIRINGPI
	depends on BR2_TOOLCHAIN_HAS_THREADS
	help
		ADS1115 is a temperature/humidity/air pressure I2C sensor

comment "adsadcd needs a toolchain w/ threads"
	depends on BR2_USE_MMU
	depends on !BR2_TOOLCHAIN_HAS_THREADS
```

## package/bme280d/Config.in
```kconfig
config BR2_PACKAGE_BME280D
	bool "bme280d"
	depends on BR2_PACKAGE_WIRINGPI
	depends on BR2_TOOLCHAIN_HAS_THREADS
	help
		BME280 is a temperature/humidity/air pressure I2C sensor

comment "bme280d needs a toolchain w/ threads"
	depends on BR2_USE_MMU
	depends on !BR2_TOOLCHAIN_HAS_THREADS
```

## package/cc1101d/Config.in
```kconfig
config BR2_PACKAGE_CC1101D
	bool "cc1101d"
	depends on BR2_PACKAGE_WIRINGPI
	depends on BR2_TOOLCHAIN_HAS_THREADS
	help
		Texas Instruments CC1101 support for Oregon Scientific
		Weather sensors

comment "cc1101d needs a toolchain w/ threads"
	depends on BR2_USE_MMU
	depends on !BR2_TOOLCHAIN_HAS_THREADS
```

## project/ezgrow/Config.in
```kconfig
source "$BR2_EXTERNAL_EZGROW_PATH/package/cc1101d/Config.in"
source "$BR2_EXTERNAL_EZGROW_PATH/package/bme280d/Config.in"
source "$BR2_EXTERNAL_EZGROW_PATH/package/adsadcd/Config.in"
```
