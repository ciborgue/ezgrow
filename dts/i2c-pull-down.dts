/dts-v1/;
/plugin/;

/ {
    compatible = "brcm,bcm2708";

    fragment@0 {
        target = <&gpio>;
        __overlay__ {
            /* pinctrl-names = "default"; */
            pinctrl-0 = <&pull_pins>;

            pull_pins: pull_pins {
                brcm,pins = <2 3>;     /* gpio no.           */
                brcm,function = <0 0>; /* 0:in, 1:out        */
                brcm,pull = <1 1>;     /* 2:up 1:down 0:none */
            };
        };
    };
};
